/**
  ******************************************************************************
  * @file    temp_sample.c
  * @author  
  * @version V1.0.0
  * @date    
  * @brief   提供温度采样相关的功能
  ******************************************************************************
  * @copy
  *
  */ 
#include "TEMP_Sample.h"
#include "usart.h"
	



//NTC热敏电阻查询方式基本节点
//用于保存温度-阻值关系
typedef struct{
	float temperature;
	float resistor;
	
}RT_node;


/*****************************************************************************
 函 数 名  : wash_sampling_linearcalc
 功能描述  : 利用线性关系和相邻两点TR值计算出目标温度值
 输入参数  : float R
 				float tem1
 				float res1
 				float tem2
 				float res2
 输出参数  : float T
 返 回 值  : float
 
 修改历史      :
  1.日    期   : 2014年5月23日
    作    者   : Gao.J

    修改内容   : 新生成函数

*****************************************************************************/
float wash_sampling_linearcalc( float R, float tem1, float res1, float tem2, float res2 )
{
    float T = 0.0;
    
	//利用线性关系  (R - res1)/(T - tem1) = (res2 - res1)/(tem2 - tem1)	
    if(res2 != res1)
    {        
        T = (R - res1) * ((tem2 - tem1) / (res2 - res1)) + tem1;
    }
    else
    {
        T = tem1;
    }
	return T;
}



/*****************************************************************************
 函 数 名  : wash_sampling_RtoTconvert
 功能描述  : 阻值-温度查表
 输入参数  : float res
 输出参数  : float* temperature

 返 回 值  : void
 
 修改历史      :
  1.日    期   : 2014年5月23日
    作    者   : Gao.J
  2.日    期   : 2015年5月20日
    作    者   : PengChuan

    修改内容   : 修改阻值温度查询流程

*****************************************************************************/
//const RT_node RT_TABLE[] = {
//		{0 , 27.550},{1 , 26.37},{2 , 25.25},{3 , 24.19},{4 , 23.18},
//		{5 , 22.210},{6 , 21.29},{7 , 20.42},{8 , 19.58},{9 , 18.79},
//		{10, 18.030},{11, 17.30},{12, 16.61},{13, 15.95},{14, 15.33},
//		{15, 14.720},{16, 14.15},{17, 13.60},{18, 13.08},{19, 12.58},
//		{20, 12.100},{21, 11.64},{22, 11.20},{23, 10.78},{24, 10.38},
//		{25, 10.000},{26, 9.632},{27, 9.279},{28, 8.941},{29, 8.617},
//		{30,  8.307},{31, 8.010},{32, 7.724},{33, 7.451},{34, 7.188},
//		{35,  6.936},{36, 6.695},{37, 6.463},{38, 6.240},{39, 6.026},
//		{40,  5.820},{41, 5.623},{42, 5.433},{43, 5.251},{44, 5.076},
//		{45,  4.907},{46, 4.745},{47, 4.589},{48, 4.439},{49, 4.295},
//		{50,  4.156},{51, 4.023},{52, 3.895},{53, 3.772},{54, 3.653},
//		{55,  3.538},{56, 3.428},{57, 3.321},{58, 3.219},{59, 3.119},
//		{60,  3.024}};

const RT_node RT_TABLE[] = {
	{-30,113.6351},{-29,107.9956},{-28,102.6661},{-27,96.6273},{-26,92.8628},
		{-25,88.3665},{-24,84.0929},{-23,80.0578},{-22,76.2379},{-21,72.6209},
		{-20,69.1948},{-19,65.9481},{-18,62.8718},{-17,59.9546},{-16,57.1883},
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		{86, 1.3989},{87, 1.3613},{88, 1.3246},{89, 1.2890},{90,1.2553},
};

void wash_sampling_RtoTconvert( float Res, float* temperature)
{
	

 
    uint16_t usloopvar  = 0;
    uint16_t usarraylen = 0;
    
    /* 计算数组长度*/
    usarraylen = (uint16_t)sizeof(RT_TABLE);

		if (RT_TABLE[0].resistor <= Res)
		{//小于整机清洗温控所需处理的最小温度
	    *temperature = RT_TABLE[0].temperature;
//	    printf("温度低于零度线");
	    return;
		}

    if (RT_TABLE[usarraylen - 1].resistor >= Res)
    {//大于整机清洗温控所需处理的最大温度
            *temperature = RT_TABLE[usarraylen - 1].temperature;
//						printf("温度超过了40度");
            return;
	}
    
    for (usloopvar = 1; usloopvar < usarraylen; usloopvar++)
		{
			if(Res >= RT_TABLE[usloopvar].resistor)
            {
						break;
		    }	
        }	
	
	//异常保护
	  if (usloopvar >= usarraylen)
		{
	    *temperature = RT_TABLE[usarraylen - 1].temperature;
	    return;
	    }

		/* 利用线性关系计算该点温度值 */
		*temperature = wash_sampling_linearcalc(Res, RT_TABLE[usloopvar].temperature, 
	                                               RT_TABLE[usloopvar].resistor,
	                                               RT_TABLE[usloopvar - 1].temperature,
									                               RT_TABLE[usloopvar - 1].resistor);
			return;
}


//计算电压值
float  ADValueToVoltage(uint16_t adValue)
{
 float  ReferenceVoltage =3.3;//基准电压
 float  FullADValue =4095.0;//满量程的AD值
	
	
	return (ReferenceVoltage/FullADValue)*(float)adValue;

}

void PrintFloat(float value)
{
    int tmp,tmp1,tmp2;
    tmp = (int)value;
    tmp1=(int)((value-tmp)*10)%10;
    tmp2=(int)((value-tmp)*100)%10;
    printf("value=%d.%d%d\r\n",tmp,tmp1,tmp2);
}
/*****************************************************************************
 函 数 名  : wash_sampling_adtotemp
 功能描述  : 利用AD值获取清洗水温度
 输入参数  : uint32_t adval 
 输出参数  : 无
 返 回 值  : float
 
 修改历史      :
  1.日    期   : 2014年5月26日
    作    者   : Gao.J
  2.日    期   : 2015年5月20日
    作    者   : PengChuan
    修改内容   : 修改温度查询函数

*****************************************************************************/
float wash_sampling_adtotemp(uint16_t adval)
{
	 char *s;
    float Uad = 0.0;
    float dstval = 0.0;
    float dsttemp = 0.0;
	
    Uad = ADValueToVoltage(adval);//adtovoltage(adval);
//    printf("当前的电压值：\n");
//     PrintFloat(Uad);
    dstval = voltagetores(Uad);
//  	printf(" 测得的阻值： \n");
//	PrintFloat(dstval);
    //dsttemp目标温度值，利用查询法得出
    wash_sampling_RtoTconvert(dstval, &dsttemp);
    return dsttemp;
}

